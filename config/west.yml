## config/west.yml
```yaml
manifest:
  remotes:
    - name: zmkfirmware
      url-base: https://github.com/zmkfirmware
    - name: mctechnology17
      url-base: https://github.com/mctechnology17
    - name: 1seanr
      url-base: https://github.com/1seanr
    - name: eyelash
      url-base: https://github.com/a741725193
  projects:
    - name: zmk
      remote: zmkfirmware
      revision: v0.3.0
      import: app/west.yml
    - name: zmk-nice-oled
      remote: 1seanr
      revision: 7a9f0741a3640b7b65775a0d2ad79540acabf9cf
    - name: zmk-board-eyelash
      remote: eyelash
      revision: a90ac672bf570970b91a46967c177fcad41a2e44
  self:
    path: config
```
